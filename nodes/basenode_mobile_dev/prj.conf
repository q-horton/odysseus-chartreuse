## CMakeLists.txt
```
# SPDX-License-Identifier: Apache-2.0

cmake_minimum_required(VERSION 3.20.0)
find_package(Zephyr REQUIRED HINTS $ENV{ZEPHYR_BASE})
project(basenode_dev)

target_sources(app PRIVATE 
    src/main.c
    src/ble_observer_ext_ad.c
)

# Include directories
target_include_directories(app PRIVATE 
    ../../../include
)
```

## prj.conf
```kconfig
CONFIG_GPIO=y
CONFIG_STDOUT_CONSOLE=y
CONFIG_PRINTK=y
CONFIG_THREAD_NAME=y 
CONFIG_SCHED_CPU_MASK=y
CONFIG_SHELL=y

CONFIG_BT=y
CONFIG_BT_OBSERVER=y
CONFIG_BT_PERIPHERAL=y

# # Enable Extended Scanning
CONFIG_BT_EXT_ADV=y
# Maximum Extended Scanning buffer size
CONFIG_BT_EXT_SCAN_BUF_SIZE=1650
# Zephyr Bluetooth LE Controller needs 16 event buffers to generate Extended
# Advertising Report for receiving the complete 1650 bytes of data
CONFIG_BT_BUF_EVT_RX_COUNT=16
# Set maximum scan data length for Extended Scanning in Bluetooth LE Controller
CONFIG_BT_CTLR_SCAN_DATA_LEN_MAX=1650


CONFIG_BT_EXT_ADV_MAX_ADV_SET=2
CONFIG_BT_USER_PHY_UPDATE=y
CONFIG_BT_CTLR_ADVANCED_FEATURES=y
# Enable Advertising Data chaining in Zephyr Bluetooth LE Controller
CONFIG_BT_CTLR_ADV_DATA_CHAIN=y
CONFIG_BT_CTLR_ADV_DATA_LEN_MAX=1650
# Increase Advertising PDU buffers to number of advertising sets times the
# number of chain PDUs per advertising set when using Zephyr Bluetooth LE
# Controller
CONFIG_BT_CTLR_ADV_DATA_BUF_MAX=2
# Increase Zephyr Bluetooth LE Controller Rx buffer to receive complete chain of PDUs
CONFIG_BT_CTLR_RX_BUFFERS=9
```

## src/main.c
```c
/*
* TODO: 
* - Merge with encoding from sensornode
*/

#include <zephyr/kernel.h>
#include <zephyr/sys/printk.h>
#include <zephyr/bluetooth/bluetooth.h>
#include <zephyr/bluetooth/hci.h>

#define SENSOR_ADV_INTERVAL_MS 1000
#define DEVICE_NAME "BaseNode"

K_SEM_DEFINE(timer_access, 1, 1); // Semaphore for synchronization

int observer_start(void);

static uint8_t basenode_adv_payload_general[5] = {0};  // Room for mobile node data
static struct bt_data ad[] = {
    BT_DATA_BYTES(BT_DATA_FLAGS, (BT_LE_AD_GENERAL | BT_LE_AD_NO_BREDR)),
	BT_DATA(BT_DATA_NAME_COMPLETE, DEVICE_NAME, sizeof(DEVICE_NAME) - 1),
    BT_DATA(BT_DATA_MANUFACTURER_DATA, basenode_adv_payload_general, sizeof(basenode_adv_payload_general)),
};

// Mobile Node Data
static struct k_timer second_timer;
static uint32_t current_time = 0;
uint8_t flags = 0x10; // Polling Rate (hrs) / Disable Sensors

void timer_handler(struct k_timer *dummy) {
    
	k_sem_take(&timer_access, K_FOREVER);
	current_time += 1;
	// Wraparound once max value reached
	if (current_time >= 0xFFFFFFFF) {
        current_time = 1;  // Reset to 1 to avoid zero timestamp
    }
	k_sem_give(&timer_access); 
}

// Function to update the mobile node's advertising payload
static void update_base_adv_payload_general(void) {
	// Update the advertising payload with the current time
	
	k_sem_take(&timer_access, K_FOREVER); // Wait for access to the timer
	basenode_adv_payload_general[0] = (current_time >> 0) & 0xFF;   // Byte 0 (LSB)
    basenode_adv_payload_general[1] = (current_time >> 8) & 0xFF;   
    basenode_adv_payload_general[2] = (current_time >> 16) & 0xFF;  
    basenode_adv_payload_general[3] = (current_time >> 24) & 0xFF;
	basenode_adv_payload_general[4] = flags;  
	k_sem_give(&timer_access); // Allow access to the timer

	// Print updated count value and flags
	printk("[BASENODE-LOG] Adv Payload Updated: Time: %u, Flags: 0x%02X\n", current_time, flags);
}

int main(void) {
	
	int err;
	printk("[BASENODE-LOG] Starting BaseNode...\n");

	k_timer_init(&second_timer, timer_handler, NULL);
    k_timer_start(&second_timer, K_SECONDS(1), K_SECONDS(1));

	// Initialise the Bluetooth Subsystem 
	err = bt_enable(NULL);
	if (err) {
		printk("Bluetooth init failed (err %d).\n", err);
		return -1;
	}

	// Start scanner
	(void) observer_start();

	// Begin advertising
	err = bt_le_adv_start(
		BT_LE_ADV_PARAM(
			BT_LE_ADV_OPT_USE_IDENTITY,
			BT_GAP_ADV_FAST_INT_MIN_2,
			BT_GAP_ADV_FAST_INT_MAX_2,
			NULL),
		ad, ARRAY_SIZE(ad), NULL, 0);
    if (err) {
        printk("Advertising failed to start (err %d).\n", err);
        return -1;
    }

	while (1) {
        update_base_adv_payload_general();
        bt_le_adv_update_data(ad, ARRAY_SIZE(ad), NULL, 0);
        k_sleep(K_MSEC(SENSOR_ADV_INTERVAL_MS));
    }

	printk("Exiting %s thread.\n", __func__);

	return 0;
}
```

## src/ble_observer_ext_ad.c
```c
/*
 * Copyright (c) 2022 Nordic Semiconductor ASA
 * Copyright (c) 2015-2016 Intel Corporation
 *
 * SPDX-License-Identifier: Apache-2.0
 */

// MODIFIED FROM SAMPLE CODE, ADDED RSSI THRESHOLD, DATA PARSING, NODE SELECTION

#include <zephyr/sys/printk.h>
#include <zephyr/bluetooth/bluetooth.h>
#include <zephyr/bluetooth/hci.h>
#include <string.h>

#define NAME_LEN 30
#define RSSI_THRESHOLD -50 // RSSI threshold for filtering devices
#define MOBILE_NODE_MAC "DC:B1:BE:10:38:1E (random)"
#define MIN_INTERVAL_FOR_UPDATES 10

// array of MAC addresses to filter
const char *nodes_of_interest[] = {
	"DC:B1:BE:10:38:1E (random)"
};

// structure to store sensordata from various nodes scraped
struct node_of_interest {
	char mac_id[NAME_LEN];
	// timestamp
	uint32_t timestamp;
	uint8_t counter;
	int16_t temperature_raw;
	uint16_t battery_mv;
};
// store all sensordata scraped from the nodes of interest
struct node_of_interest nodes[10]; // array of 10 nodes

const bt_addr_le_t target_addr = {
	.type = BT_ADDR_LE_RANDOM, 
	.a = { .val = {0xC5, 0x84, 0x32, 0xCA, 0x99, 0xCA} }
};


static bool parse_ad_data(struct bt_data *data, void *user_data) {

    if (data->type == BT_DATA_MANUFACTURER_DATA && data->data_len >= 5) {
        const uint8_t *payload = data->data;

		printk("[BASENODE-DEBUG] Received From Mobile: ");
		for (int i = 0; i < data->data_len; i++) {
			printk("%02X ", payload[i]);
		}
		printk("\n");
    }
    return true;
}

static void scan_recv(const struct bt_le_scan_recv_info *info, struct net_buf_simple *buf) {
	
	if (info->rssi < RSSI_THRESHOLD) {
		//printk("Ignoring weak signal from %s (RSSI %d)\n", le_addr, info->rssi);
		return; // Ignore weak signals
	}

	if (!(info->adv_props & BT_GAP_ADV_PROP_EXT_ADV)) { 
        // Not extended advertising, skip it
        return;
    }
	
	char le_addr[BT_ADDR_LE_STR_LEN];
	bt_addr_le_to_str(info->addr, le_addr, sizeof(le_addr));
	printk("[BASENODE-LOG] DEVICE: %s, RSSI: %d, Data len: %u\n", le_addr, info->rssi, buf->len);
	
    if (strcmp(le_addr, MOBILE_NODE_MAC) == 0) {
        bt_data_parse(buf, parse_ad_data, NULL);
        //k_sleep(K_MSEC(1000));
    }
}

static struct bt_le_scan_cb scan_callbacks = {
	.recv = scan_recv,
};

int observer_start(void) {

	struct bt_le_scan_param scan_param = {
		.type       = BT_LE_SCAN_TYPE_PASSIVE,
		//.options    = BT_LE_SCAN_OPT_FILTER_DUPLICATE,
		.interval   = BT_GAP_SCAN_FAST_INTERVAL,
		.window     = BT_GAP_SCAN_FAST_WINDOW,
	};
	int err;

	// Only applies for BLE using extended advertising
	bt_le_scan_cb_register(&scan_callbacks);
	printk("[BASENODE-LOG] Registered scan callbacks\n");
	
	err = bt_le_scan_start(&scan_param, NULL); // do nothing if legacy ble device found (previously calls device_found)
	if (err) {
		printk("Start scanning failed (err %d)\n", err);
		return err;
	}
	printk("[BASENODE-LOG] Started scanning...\n");

	return 0;
}
```
