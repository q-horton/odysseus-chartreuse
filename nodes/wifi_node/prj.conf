## CMakeLists.txt
```
# SPDX-License-Identifier: Apache-2.0
cmake_minimum_required(VERSION 3.20.0)
find_package(Zephyr REQUIRED HINTS $ENV{ZEPHYR_BASE})
project(wifi_node)

FILE(GLOB app_sources src/*.c)

target_sources(
    app 
    PRIVATE 
        ${app_sources} 
)

target_include_directories(app PRIVATE include)
```

## prj.conf
```kconfig
CONFIG_MAIN_STACK_SIZE=4096

CONFIG_WIFI=y

CONFIG_NETWORKING=y

CONFIG_NET_IPV4=y
CONFIG_NET_IPV6=n
CONFIG_NET_TCP=y
CONFIG_NET_SOCKETS=y
CONFIG_NET_LOG=y
#CONFIG_NET_CONFIG_INIT_TIMEOUT=30
CONFIG_NET_L2_ETHERNET=y
CONFIG_NET_DHCPV4=y

CONFIG_DNS_RESOLVER=y

#CONFIG_LOG_BUFFER_SIZE=4096

CONFIG_MQTT_LIB=y
CONFIG_MQTT_LOG_LEVEL_DBG=y

CONFIG_PRINTK=y
CONFIG_STDOUT_CONSOLE=y

CONFIG_POSIX_API=y

CONFIG_SHELL=y
CONFIG_NET_SHELL=y
CONFIG_NET_L2_WIFI_SHELL=y
CONFIG_NET_STATISTICS=y

CONFIG_SPI=y
CONFIG_SPI_ASYNC=y
```

## boards/esp32c3_devkitm.conf
```kconfig
CONFIG_ESP32_WIFI_STA_AUTO_DHCPV4=y

CONFIG_ESP_WIFI_HEAP_SYSTEM=y
CONFIG_HEAP_MEM_POOL_SIZE=51200
```

## src/main.c
```c
#include <zephyr/kernel.h>
#include <zephyr/device.h>

#include <string.h>
#include <stdint.h>
#include <stdio.h>

#include "wifi.h"
#include "mqtt.h"

//#define SSID "csse4011"
//#define PASSWORD "csse4011wifi"
#define SSID "NOKIA-F7C1"
#define PASSWORD "59a372e43d"

#define MQTT_BROKER_PORT 1883
#define MQTT_BROKER_ADDR "192.168.0.114"

int main() {
    int ret;

    wifi_init();

    ret = wifi_connect(SSID, PASSWORD);
    if (ret < 0) {
        printk("Error (%d): WiFi connection failed\n", ret);
        return 0;
    }

    wifi_wait_for_ip();

    return 0;
}
```

## include/mqtt.h
```c
#ifndef MQTT_NODE_H
#define MQTT_NODE_H

int mqtt_connect_to_broker(char* broker_ip, int port);
void mqtt_send_data(char* topic, char* data);

#endif // MQTT_NODE_H
```

## include/wifi.h
```c
#ifndef WIFI_H
#define WIFI_H

void wifi_init(void);

void wifi_wait_for_ip(void);

int wifi_connect(char *ssid, char* passkey);
int wifi_disconnect(void);

#endif // WIFI_H
```

## src/mqtt.c
```c
#include <zephyr/kernel.h>
#include <zephyr/net/socket.h>
#include <zephyr/net/mqtt.h>

#include "mqtt.h"

#define MQTT_THREAD_STACK_SIZE 4096
#define MQTT_THREAD_PRIORITY 1

/* Buffers for MQTT client. */
static uint8_t rx_buffer[256];
static uint8_t tx_buffer[256];

/* MQTT client context */
static struct mqtt_client client_ctx;

/* MQTT Broker address information. */
static struct sockaddr_storage broker;

static struct pollfd fds[1];

static K_SEM_DEFINE(sem_mqtt, 0, 1);

void mqtt_evt_handler(struct mqtt_client *client,
        const struct mqtt_evt *evt)
{
    //printk("MQTT Event: %d\n", evt->type);

    switch (evt->type) {
        /* Handle events here. */
        case MQTT_EVT_CONNACK:
            k_sem_give(&sem_mqtt);
            break;

        case MQTT_EVT_DISCONNECT:
            k_sem_take(&sem_mqtt, K_NO_WAIT);
            break;

        default:
            break;
    }
}

int mqtt_connect_to_broker(char* broker_ip, int port) {
    int ret;

    mqtt_client_init(&client_ctx);

    struct sockaddr_in *broker4 = (struct sockaddr_in *)&broker;
    broker4->sin_family = AF_INET;
    broker4->sin_port = htons(port);
    inet_pton(AF_INET, broker_ip, &broker4->sin_addr);

    // MQTT client configuration
    client_ctx.broker = &broker;
    client_ctx.evt_cb = mqtt_evt_handler;
    client_ctx.client_id.utf8 = (uint8_t *)"zephyr_mqtt_client";
    client_ctx.client_id.size = sizeof("zephyr_mqtt_client") - 1;
    client_ctx.password = NULL;
    client_ctx.user_name = NULL;
    client_ctx.protocol_version = MQTT_VERSION_3_1_1;
    client_ctx.transport.type = MQTT_TRANSPORT_NON_SECURE;

    // MQTT buffers configuration
    client_ctx.rx_buf = rx_buffer;
    client_ctx.rx_buf_size = sizeof(rx_buffer);
    client_ctx.tx_buf = tx_buffer;
    client_ctx.tx_buf_size = sizeof(tx_buffer);

    ret = mqtt_connect(&client_ctx);
    if (ret != 0) {
        return ret;
    }

    fds[0].fd = client_ctx.transport.tcp.sock;
    fds[0].events = ZSOCK_POLLIN;
    poll(fds, 1, 5000);
    
    mqtt_input(&client_ctx);

    
    return ret;
}

void mqtt_send_data(char* topic, char* data) {
    struct mqtt_publish_param param = { 0 };
    param.message.topic.topic.utf8 = (uint8_t *)topic;
    param.message.topic.topic.size =
        strlen(param.message.topic.topic.utf8);
    param.message.topic.qos = MQTT_QOS_0_AT_MOST_ONCE;
    param.message.payload.data = data;
    param.message.payload.len =
        strlen(param.message.payload.data);
    param.message_id = 43;
    param.dup_flag = 0U;
    param.retain_flag = 0U;
    
    mqtt_publish(&client_ctx, &param);
}

void mqtt_thread() {
    while (1) {

        if (k_sem_count_get(&sem_mqtt) == 1) {
            mqtt_live(&client_ctx);
        }

        k_msleep(1000);    
    }
}

K_THREAD_DEFINE(mqtt_tid, MQTT_THREAD_STACK_SIZE,
                mqtt_thread, NULL, NULL, NULL,
                MQTT_THREAD_PRIORITY, 0, 0);
```

## src/shell_cmds.c
```c
#include <zephyr/shell/shell.h>

#include <stdlib.h>

#include "mqtt.h"

static int cmd_mqtt_connect(const struct shell *sh, size_t argc,
                           char **argv)
{
    int ret;

    char *addr = argv[1];
    int port = atoi(argv[2]);

    ret = mqtt_connect_to_broker(addr, port);
    if (ret != 0) {
        shell_error(sh, "Error (%d): MQTT connect failed: %s", ret, strerror(-ret));
    }
}

static int cmd_mqtt_publish(const struct shell *sh, size_t argc,
                           char **argv)
{
    mqtt_send_data(argv[1], argv[2]);

    return 0;
}

SHELL_STATIC_SUBCMD_SET_CREATE(sub_mqtt,
        SHELL_CMD_ARG(connect, NULL, "Usage: mqtt connect <broker ip> <port>", cmd_mqtt_connect, 3, 0),
        SHELL_CMD_ARG(publish, NULL, "Usage: mqtt publish <topic> <data>", cmd_mqtt_publish, 3, 0),
        SHELL_SUBCMD_SET_END
);

SHELL_CMD_REGISTER(mqtt, &sub_mqtt, "MQTT commands", NULL);
```

## src/wifi.c
```c
#include <zephyr/kernel.h>
#include <zephyr/net/wifi_mgmt.h>

#include <string.h>
#include <stdint.h>

#include "wifi.h"
#include "zephyr/net/net_if.h"
#include "zephyr/net/net_ip.h"
#include "zephyr/net/net_mgmt.h"
#include "zephyr/net/wifi.h"

static struct net_mgmt_event_callback wifi_cb;
static struct net_mgmt_event_callback ipv4_cb;

static K_SEM_DEFINE(sem_wifi, 0, 1);
static K_SEM_DEFINE(sem_ipv4, 0, 1);

static void on_wifi_connection_event(struct net_mgmt_event_callback *cb, 
        uint32_t mgmt_event, 
        struct net_if *iface) 
{
    const struct wifi_status *status = (const struct wifi_status *)cb->info;

    if (mgmt_event == NET_EVENT_WIFI_CONNECT_RESULT) {
        if (status->status) {
            printk("Error (%d): Connection request failed\n", status->status);
        } 
        else {
            printk("Connection successful.\n");
            k_sem_give(&sem_wifi);
        }
    }
    else if (mgmt_event == NET_EVENT_WIFI_DISCONNECT_RESULT) {
        if (status->status) {
            printk("Error (%d): Disconnect request failed\n", status->status);
        } 
        else {
            printk("Disconnect successful.\n");
            k_sem_take(&sem_wifi, K_NO_WAIT);
        }
    }
}

static void on_ipv4_obtained(struct net_mgmt_event_callback *cb, 
        uint32_t mgmt_event, 
        struct net_if *iface) 
{
    if (mgmt_event == NET_EVENT_IPV4_ADDR_ADD) {
        k_sem_give(&sem_ipv4);
    }
}

void wifi_init() {
    net_mgmt_init_event_callback(&wifi_cb, on_wifi_connection_event, NET_EVENT_WIFI_CONNECT_RESULT | NET_EVENT_WIFI_DISCONNECT_RESULT);
    net_mgmt_init_event_callback(&ipv4_cb, on_ipv4_obtained, NET_EVENT_IPV4_ADDR_ADD);

    net_mgmt_add_event_callback(&wifi_cb);
    net_mgmt_add_event_callback(&ipv4_cb);
}

int wifi_connect(char *ssid, char* passkey) {
    int rv;
    struct net_if *iface;
    struct wifi_connect_req_params params;

    iface = net_if_get_default();

    params.ssid = (const uint8_t *)ssid;
    params.ssid_length = strlen(ssid);
    params.psk = (const uint8_t *)passkey;
    params.psk_length = strlen(passkey);

    params.security = WIFI_SECURITY_TYPE_PSK;
    params.band = WIFI_FREQ_BAND_UNKNOWN;
    params.channel = WIFI_CHANNEL_ANY;
    params.mfp = WIFI_MFP_OPTIONAL;

    rv = net_mgmt(NET_REQUEST_WIFI_CONNECT, iface, &params, sizeof(params));
    k_sem_take(&sem_wifi, K_FOREVER);

    return rv;
}

void wifi_wait_for_ip(void) {
    struct wifi_iface_status status;
    struct net_if *iface;

    char ip_addr[NET_IPV4_ADDR_LEN];
    char gw_addr[NET_IPV4_ADDR_LEN];

    iface = net_if_get_default();

    k_sem_take(&sem_ipv4, K_FOREVER);

    if (net_mgmt(NET_REQUEST_WIFI_IFACE_STATUS, iface, &status, sizeof(struct wifi_iface_status))) {
        printk("Error: WiFi status request failed\n");
    }

    memset(ip_addr, 0, sizeof(ip_addr));

    if (net_addr_ntop(AF_INET, &iface->config.ip.ipv4->unicast[0].ipv4.address.in_addr, ip_addr, sizeof(ip_addr)) == NULL) {
        printk("Error: could not convert IP address to string\n");
    }

    memset(gw_addr, 0, sizeof(gw_addr));

    if (net_addr_ntop(AF_INET, &iface->config.ip.ipv4->gw, gw_addr, sizeof(gw_addr)) == NULL) {
        printk("Error: could not convert gateway address to string\n");
    }


    printk("Wifi Status (%d):\n", status.state);
    if (status.state == WIFI_STATE_COMPLETED) {
        printk("    SSID: %-32s\n", status.ssid);
        printk("    IP address: %s\n", ip_addr);
        printk("    Gateway address: %s\n", gw_addr);
    }
}

int wifi_disconnect(void) {
    int ret;
    struct net_if *iface = net_if_get_default();

    ret = net_mgmt(NET_REQUEST_WIFI_DISCONNECT, iface, NULL, 0);
    return ret;
}
```
