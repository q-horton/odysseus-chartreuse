## CMakeLists.txt
```
# SPDX-License-Identifier: Apache-2.0

cmake_minimum_required(VERSION 3.20.0)

find_package(Zephyr REQUIRED HINTS $ENV{ZEPHYR_BASE})
project(sensornode_dev)

# FILE(GLOB app_sources src/*.c src/sensornode_observer.c)
FILE(GLOB app_sources src/main.c)
target_sources(app PRIVATE
  ${app_sources}
)

zephyr_library_include_directories(${ZEPHYR_BASE}/samples/bluetooth)
```

## prj.conf
```kconfig
CONFIG_BT=y
CONFIG_BT_DEVICE_NAME="Ext_Adv_Advertiser"
CONFIG_BT_PERIPHERAL=y
CONFIG_BT_OBSERVER=y
# CONFIG_BT_BROADCASTER=y
CONFIG_BT_EXT_ADV=y

# # # Simple, Limited to 191 Bytes
# # CONFIG_BT_CTLR_ADV_DATA_LEN_MAX=191
# # CONFIG_BT_EXT_ADV_MAX_ADV_SET=2
# # CONFIG_BT_CTLR_ADVANCED_FEATURES=y
# # CONFIG_BT_CTLR_ADV_DATA_BUF_MAX=2 

CONFIG_BT_EXT_ADV_MAX_ADV_SET=2
CONFIG_BT_USER_PHY_UPDATE=y
CONFIG_BT_CTLR_ADVANCED_FEATURES=y
# Enable Advertising Data chaining in Zephyr Bluetooth LE Controller
CONFIG_BT_CTLR_ADV_DATA_CHAIN=y
CONFIG_BT_CTLR_ADV_DATA_LEN_MAX=1650
# Increase Advertising PDU buffers to number of advertising sets times the
# number of chain PDUs per advertising set when using Zephyr Bluetooth LE
# Controller
CONFIG_BT_CTLR_ADV_DATA_BUF_MAX=16
# Maximum Extended Scanning buffer size
CONFIG_BT_EXT_SCAN_BUF_SIZE=1650
# Set maximum scan data length for Extended Scanning in Bluetooth LE Controller
CONFIG_BT_CTLR_SCAN_DATA_LEN_MAX=1650
# The Zephyr Controller does not combine all the 1650 bytes before
# fragmenting into 8 HCI reports, if a PDU has 255 bytes,
# it will generate 2 HCI reports and so we need to reserve 16 buffers. Was 16.
CONFIG_BT_BUF_EVT_RX_COUNT=16
# Increase Zephyr Bluetooth LE Controller Rx buffer to receive complete chain of PDUs. Was 9
CONFIG_BT_CTLR_RX_BUFFERS=16
CONFIG_MAIN_STACK_SIZE=4096

CONFIG_ASSERT=y
```

## src/main.c
```c
#include <zephyr/kernel.h>
#include <zephyr/sys/printk.h>
#include <zephyr/bluetooth/bluetooth.h>
#include <zephyr/bluetooth/hci.h>
#include <zephyr/bluetooth/uuid.h>
#include <zephyr/bluetooth/gap.h>
#include <zephyr/logging/log.h>

LOG_MODULE_REGISTER(main, LOG_LEVEL_DBG);

#define DEVICE_NAME "SensorNode"
#define SENSOR_ADV_INTERVAL_MS 1000
#define NAME_LEN 30
#define RSSI_THRESHOLD -50 // RSSI threshold for filtering devices
#define MOBILE_NODE_MAC_ADDR "DC:B1:BE:10:38:1E (random)" // MAC address of Mobile Node
#define MIN_INTERVAL_FOR_UPDATES 10 // Minimum interval in seconds for updates

// --- Global Variables ---
K_SEM_DEFINE(config_data, 1, 1); // Semaphore for synchronization

uint32_t current_time = 0; // Current time in s
uint32_t previous_time = 0; 
uint64_t current_time_ms = 0;
uint8_t config_set_externally = 0;
uint8_t polling_flag = 1; // Determines poll rate, ignored for now 

// Custom sensor data payload, length + 5 bytes < 255
__aligned(4) static uint8_t adv_payload[230] = {0};  
// To use max of 1650, define multuple adv_payloads, and add in ad[] below (TBD)
__aligned(4) static uint8_t adv_payload_two[230] = {0}; // For future use
// __aligned(4) static uint8_t adv_payload_3[230] = {0}; // For future use
// static uint8_t adv_payload_4[240]; // For future use

static struct bt_data ad[] = {
    BT_DATA_BYTES(BT_DATA_FLAGS, (BT_LE_AD_GENERAL | BT_LE_AD_NO_BREDR)),
    BT_DATA(BT_DATA_NAME_COMPLETE, DEVICE_NAME, sizeof(DEVICE_NAME) - 1),
    BT_DATA(BT_DATA_MANUFACTURER_DATA, adv_payload, sizeof(adv_payload)),
    BT_DATA(BT_DATA_MANUFACTURER_DATA, adv_payload_two, sizeof(adv_payload_two)),
    //BT_DATA(BT_DATA_MANUFACTURER_DATA, adv_payload_3, sizeof(adv_payload_3)),
    // BT_DATA(BT_DATA_MANUFACTURER_DATA, adv_payload_4, sizeof(adv_payload_4)),
};

static struct bt_le_ext_adv *adv_set;
static struct k_timer second_timer;

void timer_handler(struct k_timer *dummy) {
    current_time++;
}

void update_adv_payload(void) {

    // Put first current_time into first 4 bytes of adv_payload
    k_sem_take(&config_data, K_FOREVER);
    //current_time = config_set_externally ? current_time : k_uptime_seconds();; // Use externally set time if available
    adv_payload[0] = current_time & 0xFF; // LSB
    adv_payload[1] = (current_time >> 8) & 0xFF;
    adv_payload[2] = (current_time >> 16) & 0xFF;
    adv_payload[3] = (current_time >> 24) & 0xFF; // MSB
    k_sem_give(&config_data);

    // Also add mac address of this device (as hex constants)

    // Remaining Sensor Data filler here

    // Remaining bytes can remain zero
    for (int i = 5; i < sizeof(adv_payload); i++) {
        adv_payload[i] = 0x01;
    }
    // fill adv_payload_two with some data for future use
    for (int i = 0; i < sizeof(adv_payload_two); i++) {
        adv_payload_two[i] = current_time & 0xFF; // Example data
    }

    // print the payload for debugging
    printk("[SENSORNODE-LOG] Updated advertisement payload: ");
    for (int i = 0; i < sizeof(adv_payload); i++) {
        printk("%02X ", adv_payload[i]);
    }
    for (int i = 0; i < sizeof(adv_payload_two); i++) {
        printk("%02X ", adv_payload_two[i]);
    }
    printk("\n");

}

static bool parse_ad_data(struct bt_data *data, void *user_data) {

    if (data->type == BT_DATA_MANUFACTURER_DATA && data->data_len >= 5) {
        k_sem_take(&config_data, K_FOREVER); 
        const uint8_t *payload = data->data;

        // Based on the above, extract current_time_ms
        uint32_t newtime = (payload[0] | (payload[1] << 8) | (payload[2] << 16) | (payload[3] << 24));
        int32_t time_delta = (int32_t)(newtime - current_time);

        if (time_delta > MIN_INTERVAL_FOR_UPDATES || time_delta < -MIN_INTERVAL_FOR_UPDATES || polling_flag != payload[4]) {
            printk("[SENSORNODE-LOG] Received new time: %u, Polling flag: %u\n", newtime, payload[4]);
            current_time = newtime;
            polling_flag = payload[4];
            config_set_externally = 1;
        }
        k_sem_give(&config_data);
    }
    return true;
}

static void device_found(const bt_addr_le_t *addr, int8_t rssi, uint8_t type, struct net_buf_simple *ad) {
	
    if (rssi < RSSI_THRESHOLD || type == BT_GAP_ADV_TYPE_EXT_ADV) {
		return; // Ignore weak signals and extended advertisements
	}
	char addr_str[BT_ADDR_LE_STR_LEN];
	bt_addr_le_to_str(addr, addr_str, sizeof(addr_str));

	// Parse the advertisement data if the device is of interest
    if (strcmp(addr_str, MOBILE_NODE_MAC_ADDR) == 0) {
        bt_data_parse(ad, parse_ad_data, NULL);
        k_sleep(K_MSEC(1000));
        //return;
    }
}

int main(void) {
    int err;

    k_timer_init(&second_timer, timer_handler, NULL);
    k_timer_start(&second_timer, K_SECONDS(1), K_SECONDS(1));

    // For Extended Advertising
    struct bt_le_adv_param adv_params = BT_LE_ADV_PARAM_INIT(
        BT_LE_ADV_OPT_EXT_ADV | BT_LE_ADV_OPT_USE_IDENTITY,
        BT_GAP_ADV_FAST_INT_MIN_2,
        BT_GAP_ADV_FAST_INT_MAX_2,
        NULL);
    
    // For Observing
    struct bt_le_scan_param scan_param = {
		.type       = BT_LE_SCAN_TYPE_PASSIVE,
		.interval   = BT_GAP_SCAN_FAST_INTERVAL,
		.window     = BT_GAP_SCAN_FAST_WINDOW,
	};

    printk("[SENSORNODE-LOG] Starting SensorNode BLE extended advertiser\n");

    err = bt_enable(NULL);
    if (err) {
        printk("Bluetooth init failed (err %d)\n", err);
        return -1;
    }

    printk("[SENSORNODE-LOG] Bluetooth initialized\n");

    update_adv_payload();

    err = bt_le_ext_adv_create(&adv_params, NULL, &adv_set);
    if (err) {
        printk("Failed to create extended advertiser (err %d)\n", err);
        return -1;
    }

    err = bt_le_ext_adv_set_data(adv_set, ad, ARRAY_SIZE(ad), NULL, 0);
    if (err) {
        printk("Failed to set extended adv data (err %d)\n", err);
        return -1;
    }

    err = bt_le_ext_adv_start(adv_set, BT_LE_EXT_ADV_START_DEFAULT);
    if (err) {
        printk("Failed to start extended advertising (err %d)\n", err);
        return -1;
    }

    printk("[SENSORNODE-LOG] Extended advertising started\n");

    err = bt_le_scan_start(&scan_param, device_found);
	if (err) {
		printk("Start scanning failed (err %d)\n", err);
		return err;
	}
	printk("[SENSORNODE-LOG] Started scanning...\n");

    while (1) {

        printk("[SENSORNODE-LOG] Updating advertisement data...\n");
        bt_le_ext_adv_stop(adv_set);
        k_sleep(K_MSEC(100)); // Short delay for service to stop
        update_adv_payload();
   
        err = bt_le_ext_adv_set_data(adv_set, ad, ARRAY_SIZE(ad), NULL, 0);
        if (err) {
            printk("Failed to update extended adv data (err %d)\n", err);
            return -1;
        }

        err = bt_le_ext_adv_start(adv_set, BT_LE_EXT_ADV_START_DEFAULT);
        if (err) {
            printk("Failed to start extended advertising (err %d)\n", err);
            return -1;
        }

        k_sleep(K_MSEC(SENSOR_ADV_INTERVAL_MS - 100));
    }
}
```

## src/sensornode_observer.c
```c
/*
 * Copyright (c) 2022 Nordic Semiconductor ASA
 * Copyright (c) 2015-2016 Intel Corporation
 *
 * SPDX-License-Identifier: Apache-2.0
 */

// MODIFIED FROM SAMPLE CODE, ADDED RSSI THRESHOLD, DATA PARSING, NODE SELECTION

#include <zephyr/sys/printk.h>
#include <zephyr/bluetooth/bluetooth.h>
#include <zephyr/bluetooth/hci.h>
#include <string.h>

#define NAME_LEN 30
#define RSSI_THRESHOLD -50 // RSSI threshold for filtering devices
#define NODE_OF_INTEREST "DC:B1:BE:10:38:1E (random)" // MAC address of Mobile Node

// array of MAC addresses to filter
const char *nodes_of_interest[] = {
	"C5:84:32:CA:99:CA (random)",
};

const bt_addr_le_t target_addr = {
	.type = BT_ADDR_LE_RANDOM, 
	.a = { .val = {0xC5, 0x84, 0x32, 0xCA, 0x99, 0xCA} }
};

static bool parse_ad_data(struct bt_data *data, void *user_data) {

    if (data->type == BT_DATA_MANUFACTURER_DATA && data->data_len >= 5) {
        const uint8_t *payload = data->data;

        uint8_t counter = payload[0];
        int16_t temperature_raw = payload[1] | (payload[2] << 8);
        uint16_t battery_mv = payload[3] | (payload[4] << 8);
        //float temperature_c = ((float) temperature_raw) / 10.0f;

        printk("\t \t Sensor Data - Counter: %d, Temp: %d.%d°C, Battery: %u mV\n",
               counter, (int) temperature_raw / 10, temperature_raw % 10, battery_mv);
    }
    return true;
}

static void device_found(const bt_addr_le_t *addr, int8_t rssi, uint8_t type, struct net_buf_simple *ad) {
	if (rssi < RSSI_THRESHOLD) {
		return; // Ignore weak signals
	}
	
	char addr_str[BT_ADDR_LE_STR_LEN];

	bt_addr_le_to_str(addr, addr_str, sizeof(addr_str));
	printk("Device found: %s (RSSI %d), type %u, AD data len %u\n",
	       addr_str, rssi, type, ad->len);

	
	// Check if the device is the one we are interested in - NODE_OF_INTEREST
	//printk("Comparing %s with %s\n", addr_str, NODE_OF_INTEREST);

	// if (bt_addr_le_cmp(addr, &target_addr) == 0) {
    // 	printk("Found target device: %s\n", addr_str);
	// }

	// Parse the advertisement data if the device is of interest
	// Check if the device is in the list of nodes of interest
	for (uint8_t i = 0; i < sizeof(nodes_of_interest) / sizeof(nodes_of_interest[0]); i++) {
		if (strcmp(addr_str, nodes_of_interest[i]) == 0) {
			//printk("Found target device: %s\n", addr_str);
			bt_data_parse(ad, parse_ad_data, NULL);
			k_sleep(K_MSEC(1000));
			//return;
		}
	}
	// if (strcmp(addr_str, NODE_OF_INTEREST) == 0) {
	// 	bt_data_parse(ad, parse_ad_data, NULL);
	// 	k_sleep(K_MSEC(1000));
	// }
	
	
}


int observer_start(void) {

	struct bt_le_scan_param scan_param = {
		.type       = BT_LE_SCAN_TYPE_PASSIVE,
		.interval   = BT_GAP_SCAN_FAST_INTERVAL,
		.window     = BT_GAP_SCAN_FAST_WINDOW,
	};
	int err;

	err = bt_le_scan_start(&scan_param, device_found);
	if (err) {
		printk("Start scanning failed (err %d)\n", err);
		return err;
	}
	printk("Started scanning...\n");

	return 0;
}
```
